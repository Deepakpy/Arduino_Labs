#define maxSamplesNum  120
static int SineWave [maxSamplesNum] = {
 0x7ff, 0x86a, 0x8d5, 0x93f, 0x9a9, 0xa11, 0xa78, 0xadd, 0xb40, 0xba1,
 0xbff, 0xc5a, 0xcb2, 0xd08, 0xd59, 0xda7, 0xdf1, 0xe36, 0xe77, 0xeb4,
 0xeec, 0xf1f, 0xf4d, 0xf77, 0xf9a, 0xfb9, 0xfd2, 0xfe5, 0xff3, 0xffc,
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 0x3ff, 0x45d, 0x4be, 0x521, 0x586, 0x5ed, 0x655, 0x6bf, 0x729, 0x794
 };
String command;
int cnt2=0;
static int cosi [6] = {
 0x7ff, 0x86a, 0x8d5, 0x93f, 0x9a9, 0xa11
// 2000, 3000, 4333
 };

void setup()
{
  Serial.begin(115200);
 

}

void loop()
{
    
 if(Serial.available()){
        command = Serial.readStringUntil('\n');
 if(command.equals("plot")&&cnt2>30){
       Serial.print("###");
  int cnt2=0;     
           
        }
 
        
    }
  int cnt = 0;
cnt2++;
//  Serial.print("~");
//  //Serial.println("~ 1 2 3 4");
// for(cnt = 0; cnt<7; cnt++){
//// for(cnt = 0; cnt<15; cnt++){   
// Serial.print(' ');
//  Serial.print(cosi[cnt]);
// 
//    delay(30); 
//
//    
//  };
    Serial.print("~");
  //Serial.println("~ 1 2 3 4");
 for(cnt = 0; cnt<3; cnt++){
// for(cnt = 0; cnt<15; cnt++){   
 Serial.print(' ');
  Serial.print(cosi[cnt]);

    delay(30); 

    
  };
Serial.println();
 // cnt = 0;
 delay(300); 
}
  
